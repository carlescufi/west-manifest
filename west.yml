## west.yml
```yaml
manifest:
  remotes:
    - name: zephyrproject-rtos
      url-base: https://github.com/zephyrproject-rtos
    - name: carlescufi
      url-base: https://github.com/carlescufi
  projects:
    - name: zephyr
      remote: zephyrproject-rtos
      revision: main
      import: true
    - name: mbedtls
      path: modules/crypto/mbedtls
      repo-path: mbedtls
      revision: zephyr
      remote: carlescufi
  
  self:
    path: manifest-repo
```
